/dts-v1/;
/plugin/;

/* Kelboy2.0 device tree for the fuel gague*/


/{

	compatible = "brcm,bcm2708";
	fragment@0 {
		   target = <&i2c_arm>;
		   __overlay__ {
		   	       status = "okay";
			       #address-cells = <1>;
			       #size-cells = <0>;
			       MAX1726x@36 {
					compatible = "maxim,MAX1726x";
					reg = <0x36>;
					interrupt-parent = <&gpio>;
					interrupts = <43 2>;
					rsense          = <10>;     /* miliOhm */
					clock-frequency = <400000>;
					model-option    = <1>;      /* Model 1, 2 or 3*/
    					talrt-min   = <0>;          /* DegreeC */
					talrt-max   = <50>;         /* DegreeC */
					valrt-min   = <3000>;       /* mV */
					valrt-max   = <4500>;       /* mV */
					salrt-min   = <1>;          /* Percent */
					salrt-max   = <99>;         /* Percent */
					ialrt-min   = <(-4000)>;    /* mA */
					ialrt-max   = <4000>;       /* mA */


					/*** INI parameters ***/
					/* Option 1/2/3 */
					designcap   = /bits/ 16 <0x1F40>; /* 4000 mAh */
					ichgterm    = /bits/ 16 <0x0640>;
					vempty      = /bits/ 16 <0x9B61>; /* 3100 mV/3800 mV Vempty/Vrecovery */
					vcharge     = <4200>; /* mV */


			      		};
			      };
		};
};
