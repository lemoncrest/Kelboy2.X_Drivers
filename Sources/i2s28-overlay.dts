/dts-v1/;
/plugin/;

/{
	compatible = "brcm,bcm2708";

	fragment@0 {
		target = <&i2s_pins>;
		__overlay__ {
			brcm,pins = <28 29 30 31 32>;
			brcm,function = <6 6 6 6 4>; /* alt2 alt0 */
		};
	};

	fragment@1 {
		target = <&i2s>;
		__overlay__ {
			status = "okay";
		};
	};
};
